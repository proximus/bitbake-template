## build/conf/bblayers.conf
```bitbake
#===============================================================================
#
#          FILE:  conf/bblayer.conf
#
#         USAGE:  ---
#
#   DESCRIPTION:  BitBake first searches the current working directory for an
#                 optional conf/bblayers.conf configuration file to determine
#                 what layers BitBake needs to recognize. This file is expected
#                 to contain a BBLAYERS variable that is a space-delimited list
#                 of 'layer' directories. If there is no bblayers.conf file,
#                 then it is assumed the user has set the BBPATH and BBFILES
#                 variables directly in the environment.
#
#       OPTIONS:  ---
#  REQUIREMENTS:  ---
#          BUGS:  ---
#         NOTES:  ---
#        AUTHOR:  Samuel Gabrielsson (samuel.gabrielsson@gmail.com)
#       COMPANY:  ---
#       VERSION:  1.0
#       CREATED:  2014-12-01 09:00:00 CET
#      REVISION:  ---
#       CHANGES:  ---
#
#===============================================================================

# The BBPATH bitbakes key variable is used to search for configuration and class
# files under the conf and classes directories, respectively. TOPDIR points to
# the build directory and is set automatically by BitBake. The ":=" operator
# results in a variable's contents being expanded immediately, rather than when
# the variable is actually used.
BBPATH := "${TOPDIR}"

# Define BBLAYERS as a list of layers to enable during the build. If BBLAYERS is
# undefined and already has a value when the statement is parsed, then leave the
# value alone. This assignment is immediate.
BBLAYERS ?= " \
    ../meta-template-layer \
    "
```

## conf/bblayers.conf
```bitbake
#===============================================================================
#
#          FILE:  conf/bblayer.conf
#
#         USAGE:  ---
#
#   DESCRIPTION:  BitBake first searches the current working directory for an
#                 optional conf/bblayers.conf configuration file to determine
#                 what layers BitBake needs to recognize. This file is expected
#                 to contain a BBLAYERS variable that is a space-delimited list
#                 of 'layer' directories. If there is no bblayers.conf file,
#                 then it is assumed the user has set the BBPATH and BBFILES
#                 variables directly in the environment.
#
#       OPTIONS:  ---
#  REQUIREMENTS:  ---
#          BUGS:  ---
#         NOTES:  ---
#        AUTHOR:  Samuel Gabrielsson (samuel.gabrielsson@gmail.com)
#       COMPANY:  ---
#       VERSION:  1.0
#       CREATED:  2014-12-01 09:00:00 CET
#      REVISION:  ---
#       CHANGES:  ---
#
#===============================================================================

# This is bitbakes key variable. It is used to search for configuration and
# class files under the conf and classes directories, respectively. TOPDIR
# points to the build directory. BitBake automatically sets this variable.
BBPATH := "${TOPDIR}"
```

## meta-template-layer/conf/layer.conf
```bitbake
#===============================================================================
#
#          FILE:  conf/layer.conf
#
#         USAGE:  The layer.conf files are used to construct key variables such
#                 such as BBPATH and BBFILES. BBPATH is used to search for
#                 configuration and class files under the conf and classes
#                 directories, respectively. BBFILES is used to locate both
#                 recipe and recipe append files (.bb and .bbappend).
#
#   DESCRIPTION:  ---
#
#       OPTIONS:  ---
#  REQUIREMENTS:  ---
#          BUGS:  ---
#         NOTES:  ---
#        AUTHOR:  Samuel Gabrielsson (samuel.gabrielsson@gmail.com)
#       COMPANY:  ---
#       VERSION:  1.0
#       CREATED:  2014-12-11 09:00:00 CET
#      REVISION:  ---
#       CHANGES:  ---
#
#===============================================================================

# Append without spaces LAYERDIR to BBPATH so that BitBake can search the layers
# configuration and class files under the layers conf and classes directories.
# The variable BBPATH was first set by conf/bblayers.conf. When LAYERDIR
# variable is used inside the layer.conf configuration file, this variable
# provides the path of the current layer. The variable LAYERDIR is not available
# outside of layer.conf and references are expanded immediately when parsing of
# the file completes.
#BBPATH .= ":${LAYERDIR}"

# Append with spaces a list of recipe files BitBake uses to build software. The
# BBFILES variable supports wildcards and is a space-separated list of avaliable
# files in 'layer' directories.
BBFILES += "${LAYERDIR}/recipes-*/*/*.bb"

# Append with spaces a list of configured layers. These names are used to find
# the other BBFILE_* variables. Typically, each layer appends its name to this
# variable in its conf/layer.conf file.
#BBFILE_COLLECTIONS += "meta-template-layer"

# Immediate variable expansion to match files from BBFILES in a particular
# layer. This variable is used in the conf/layer.conf file and must be suffixed
# with the name of the specific layer (e.g. BBFILE_PATTERN_emenlow).
#BBFILE_PATTERN_meta-template-layer := "^${LAYERDIR}/"
```
